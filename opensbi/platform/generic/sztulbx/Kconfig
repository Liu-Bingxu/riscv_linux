## opensbi/platform/generic/sztulbx/Kconfig
```kconfig
menuconfig PLATFORM_SZTULBX_YSYXLBX
	bool "sztulbx ysyxlbx support"
	default n
    help
        set taget is sztulbx

if PLATFORM_SZTULBX_YSYXLBX

config SZTU_LBX_JUMP_ADDR
  hex "jump addr for next stage"
  default 0x80000000
endif
```

## u-boot-2024-01/board/sztulbx/ysyxlbx/Kconfig
```kconfig
if TARGET_SZTULBX_YSYXLBX

config SYS_BOARD
	default "ysyxlbx"

config SYS_VENDOR
	default "sztulbx"

config SYS_CPU
	default "generic"

config SYS_CONFIG_NAME
	default "sztulbx-ysyxlbx"

config SYS_STEXT_BASE
    hex
	default 0x80800000

config BOARD_SPECIFIC_OPTIONS # dummy
	def_bool y
	select GENERIC_RISCV
	imply AHCI
	imply BOARD_LATE_INIT
	imply CMD_POWEROFF
    imply CMD_SBI
	imply CMD_EXT2
	imply CMD_EXT4
	imply CMD_FAT
	imply CMD_FS_GENERIC
	imply DOS_PARTITION
	imply ISO_PARTITION
	imply EFI_PARTITION
	imply SYS_NS16550
	imply SIFIVE_SERIAL
	imply SYSRESET
	imply SYSRESET_CMD_POWEROFF
	imply SYSRESET_SYSCON
endif
```

## u-boot-2024-01/configs/sztulbx-ysyxlbx_defconfig
```kconfig
CONFIG_RISCV=y
CONFIG_NR_DRAM_BANKS=1
CONFIG_ENV_SIZE=0x20000
CONFIG_SYS_MALLOC_LEN=0x800000
CONFIG_SYS_BOOTM_LEN=0x4000000
CONFIG_TEXT_BASE=0x88000000
CONFIG_SYS_LOAD_ADDR=0x88000000
CONFIG_HAS_CUSTOM_SYS_INIT_SP_ADDR=y
CONFIG_CUSTOM_SYS_INIT_SP_ADDR=0x88000000
CONFIG_TARGET_SZTULBX_YSYXLBX=y
CONFIG_ARCH_RV64I=y
CONFIG_RISCV_SMODE=y
CONFIG_DISTRO_DEFAULTS=y
CONFIG_FIT=y
CONFIG_DISPLAY_CPUINFO=y
CONFIG_DISPLAY_BOARDINFO=y
CONFIG_CMD_BOOTEFI_SELFTEST=y
CONFIG_CMD_NVEDIT_EFI=y
CONFIG_OF_PRIOR_STAGE=y
CONFIG_SYS_RELOC_GD_ENV_ADDR=y

CONFIG_DEFAULT_DEVICE_TREE="ysyxlbx_uboot"
```
